## CMakeLists.txt
```
cmake_minimum_required(VERSION 3.20.0)
# Top-level CMakeLists.txt for the skeleton application.
#
# Copyright (c) 2017 Open Source Foundries Limited
#
# SPDX-License-Identifier: Apache-2.0
#
# This provides a basic application structure suitable for communication using
# mcumgr.  It can be used as a starting point for new applications.

# Standard Zephyr application boilerplate.
find_package(Zephyr REQUIRED HINTS $ENV{ZEPHYR_BASE})
project(smp_svr)

target_sources(app PRIVATE src/main.c)
target_sources_ifdef(CONFIG_MCUMGR_TRANSPORT_BT app PRIVATE src/bluetooth.c)
target_sources(app PRIVATE src/dfu_hooks.c)

if(DEFINED WEST_TOPDIR)
  set(mcuboot_bootutil_inc ${WEST_TOPDIR}/bootloader/mcuboot/boot/bootutil/include)
  set(mcuboot_zephyr_inc ${WEST_TOPDIR}/bootloader/mcuboot/boot/zephyr/include)
else()
  get_filename_component(west_topdir_fallback "${ZEPHYR_BASE}/.." ABSOLUTE)
  set(mcuboot_bootutil_inc ${west_topdir_fallback}/bootloader/mcuboot/boot/bootutil/include)
  set(mcuboot_zephyr_inc ${west_topdir_fallback}/bootloader/mcuboot/boot/zephyr/include)
endif()

target_include_directories(app PRIVATE ${mcuboot_bootutil_inc} ${mcuboot_zephyr_inc})

if(CONFIG_MCUMGR_TRANSPORT_UDP_DTLS)
  # Use dummy certificate files
  set(cert_dir certificates)
  set(cert_files echo-apps-cert.der;echo-apps-key.der)
  set(gen_dir ${ZEPHYR_BINARY_DIR}/include/generated)

  message(WARNING "Using dummy certificate files, these are provided for demonstration only")

  foreach(inc_file ${cert_files})
    generate_inc_file_for_target(
      app
      ${cert_dir}/${inc_file}
      ${gen_dir}/${inc_file}.inc
    )
  endforeach()

  target_sources(app PRIVATE src/udp_dtls.c)
endif()
```

## prj.conf
```kconfig
# Enable MCUmgr and dependencies.
CONFIG_NET_BUF=y
CONFIG_ZCBOR=y
CONFIG_CRC=y
CONFIG_MCUMGR=y
CONFIG_STREAM_FLASH=y
CONFIG_FLASH_MAP=y
CONFIG_MCUMGR_MGMT_NOTIFICATION_HOOKS=y

# Some command handlers require a large stack.
CONFIG_SYSTEM_WORKQUEUE_STACK_SIZE=2304
CONFIG_MAIN_STACK_SIZE=2176

# Ensure an MCUboot-compatible binary is generated.
CONFIG_BOOTLOADER_MCUBOOT=y

# Enable flash operations.
CONFIG_FLASH=y

# Required by the `taskstat` command.
CONFIG_THREAD_MONITOR=y

# Support for taskstat command
CONFIG_MCUMGR_GRP_OS_TASKSTAT=y

# Enable most core commands.
CONFIG_FLASH=y
CONFIG_IMG_MANAGER=y
CONFIG_MCUMGR_GRP_IMG=y
CONFIG_MCUMGR_GRP_IMG_STATUS_HOOKS=y
CONFIG_MCUMGR_GRP_OS=y
CONFIG_MCUMGR_GRP_STAT=y

# Enable logging
CONFIG_LOG=y
CONFIG_MCUBOOT_UTIL_LOG_LEVEL_WRN=y

# Disable debug logging
CONFIG_LOG_MAX_LEVEL=3

CONFIG_SHELL_PROMPT_UART="pico2w:~$ "
CONFIG_SHELL=y
CONFIG_NET_SHELL=y
CONFIG_NET_L2_WIFI_SHELL=y

CONFIG_WIFI=y

CONFIG_NET_DHCPV4=y

CONFIG_SHELL_STACK_SIZE=4096

CONFIG_NET_TX_STACK_SIZE=2048
CONFIG_NET_RX_STACK_SIZE=2048

CONFIG_NVS=y
CONFIG_SETTINGS=y
CONFIG_SETTINGS_NVS=y

CONFIG_WIFI_CREDENTIALS=y
CONFIG_WIFI_CREDENTIALS_BACKEND_SETTINGS=y

CONFIG_MCUMGR_GRP_IMG_CLIENT=y
CONFIG_SMP_CLIENT=y
```

## udp.conf
```kconfig
# Enable the UDP MCUmgr transport.
CONFIG_MCUMGR_TRANSPORT_UDP=y
CONFIG_MCUMGR_TRANSPORT_UDP_IPV4=y
CONFIG_MCUMGR_TRANSPORT_UDP_IPV6=y

# Network settings
CONFIG_NETWORKING=y
CONFIG_NET_UDP=y
CONFIG_NET_IPV4=y
# CONFIG_NET_IPV6=y
CONFIG_NET_SOCKETS=y
CONFIG_NET_CONNECTION_MANAGER=y
CONFIG_NET_CONFIG_SETTINGS=y
CONFIG_TEST_RANDOM_GENERATOR=y
# CONFIG_NET_CONFIG_MY_IPV4_ADDR="192.168.1.170"

# POSIX sockets (zsock_*)
CONFIG_NET_SOCKETS=y
# CONFIG_NET_SOCKETS_POSIX_NAMES=y
CONFIG_SHELL=y
```

## boards/rpi_pico2_rp2350a_m33_w_mcuboot.overlay
```dts
/ {
  chosen {
    zephyr,settings-partition = &storage_partition;
  };
}; 
```

## src/main.c
```c
#include <zephyr/app_version.h>
#include <zephyr/kernel.h>
#include <zephyr/usb/usb_device.h>
#include <zephyr/net/socket.h>
#include <zephyr/net/net_compat.h>

#include <errno.h>
#include <limits.h>
#include <stdlib.h>

#include <zephyr/shell/shell.h>

/* ---- Configure these ---- */
#define SERVER_IP   "192.168.1.145"
#define SERVER_PORT 9997
#define ENDPOINT_PORT 6500

#define DEVICE_ID "node03"

#define LOG_LEVEL LOG_LEVEL_DBG
#include <zephyr/logging/log.h>
LOG_MODULE_REGISTER(smp_sample);

#include "dfu_hooks.h"

static int get_hash(const char *ep_ip, uint16_t ep_port)
{
    int sock = zsock_socket(AF_INET, SOCK_DGRAM, IPPROTO_UDP);
    if (sock < 0)
    {
        LOG_ERR("socket() failed: %d", errno);
        return -errno;
    }

    struct sockaddr_in dst = {0};
    dst.sin_family = AF_INET;
    dst.sin_port = htons(ep_port);

    int rc = zsock_inet_pton(AF_INET, ep_ip, &dst.sin_addr);
    if (rc != 1)
    {
        LOG_ERR("inet_pton() failed for %s", ep_ip);
        zsock_close(sock);
        return -EINVAL;
    }

    char *msg = "get_hash";

    rc = zsock_sendto(sock, msg, strlen(msg), 0,
                      (struct sockaddr *)&dst, sizeof(dst));
    if (rc < 0)
    {
        rc = -errno;
        LOG_ERR("sendto() failed: %d", rc);
        goto fin;
    }

    rc = zsock_recv(sock, good_hash, sizeof(good_hash), MSG_WAITALL);
    if (rc < 0)
    {
        rc = -errno;
        LOG_ERR("Err receiving hash: %d", rc);
    }
    else if (rc != sizeof(good_hash))
    {
        LOG_ERR("Received %d/32 bytes (hash req)", rc);
        rc = -EINVAL;
    }
    else
    {
        rc = 0;
        char sha_hex[(IMG_MGMT_DATA_SHA_LEN * 2) + 1];
        bin2hex(good_hash, sizeof(good_hash), sha_hex, sizeof(sha_hex));
        LOG_WRN("got sha256=%s", sha_hex);
    }

fin:
    zsock_close(sock);
    return rc;
}

static int send_ready_ping(const char *server_ip, uint16_t server_port)
{
    int sock = zsock_socket(AF_INET, SOCK_DGRAM, IPPROTO_UDP);
    if (sock < 0)
    {
        LOG_ERR("socket() failed: %d", errno);
        return -errno;
    }

    struct sockaddr_in dst = {0};
    dst.sin_family = AF_INET;
    dst.sin_port = htons(server_port);

    int rc = zsock_inet_pton(AF_INET, server_ip, &dst.sin_addr);
    if (rc != 1)
    {
        LOG_ERR("inet_pton() failed for %s", server_ip);
        zsock_close(sock);
        return -EINVAL;
    }

    /* Minimal JSON payload */
    char msg[192];
    int len = snprintk(msg, sizeof(msg),
                       "{\"kind\":\"ping\",\"device_id\":\"%s\",\"version\":\"%s\",\"smp_port\":1337}",
                       DEVICE_ID, APP_VERSION_STRING);

    if (len <= 0 || len >= sizeof(msg))
    {
        LOG_ERR("message formatting failed");
        zsock_close(sock);
        return -EINVAL;
    }

    rc = zsock_sendto(sock, msg, len, 0,
                      (struct sockaddr *)&dst, sizeof(dst));
    if (rc < 0)
    {
        LOG_ERR("sendto() failed: %d", errno);
        zsock_close(sock);
        return -errno;
    }

    LOG_INF("Sent ready ping to %s:%d (%d bytes)", server_ip, server_port, rc);
    zsock_close(sock);
    return 0;
}

static int cmd_fwup(const struct shell *shell, size_t argc, char **argv)
{
    const char *server_ip = SERVER_IP;
    const char *endpoint_ip = SERVER_IP;
    uint16_t server_port = SERVER_PORT;
    uint16_t endpoint_port = ENDPOINT_PORT;

    if (argc > 1)
    {
        server_ip = argv[1];
    }

    if (argc > 2)
    {
        endpoint_ip = argv[2];
    }

    int rc = get_hash(endpoint_ip, endpoint_port);
    if (rc != 0)
    {
        shell_error(shell, "Failed to get hash: %d", rc);
        return rc;
    }

    rc = send_ready_ping(server_ip, server_port);
    if (rc != 0)
    {
        shell_error(shell, "Ready ping failed: %d", rc);
        return rc;
    }

    shell_print(shell, "Ready ping sent to %s:%u", server_ip, server_port);
    return 0;
}

SHELL_CMD_REGISTER(fwup, NULL, "Readiness helpers", cmd_fwup);

int main(void)
{

    /* Register the built-in mcumgr command handlers. */
    dfu_hooks_register();

    /* using __TIME__ ensure that a new binary will be built on every
     * compile which is convenient when testing firmware upgrade.
     */
    LOG_ERR("Build Time: " __DATE__ " " __TIME__);

    /* The system work queue handles all incoming mcumgr requests.  Let the
     * main thread idle while the mcumgr server runs.
     */
    // for (int i = 1; i < 30; i++) {
    // for (int i = 1; true; i++) {
    // 	k_sleep(K_MSEC(10000));
    // 	send_ready_ping(SERVER_IP, SERVER_PORT);
    // }

    return 0;
}
```

## src/dfu_hooks.c
```c
/*
 * SPDX-License-Identifier: Apache-2.0
 */

#include "dfu_hooks.h"

#include <zephyr/logging/log.h>
LOG_MODULE_REGISTER(dfu_hooks, LOG_LEVEL_INF);

#include <errno.h>

#include <zephyr/dfu/mcuboot.h>
#include <zephyr/storage/flash_map.h>
#include <zephyr/sys/util.h>

uint8_t good_hash[IMG_MGMT_DATA_SHA_LEN];

static int find_tlv_area(const struct flash_area *fa, size_t start_off, uint16_t magic,
						 size_t *tlvs_start, size_t *tlvs_end)
{
	struct image_tlv_info tlv_info;
	int rc = flash_area_read(fa, start_off, &tlv_info, sizeof(tlv_info));
	if (rc != 0)
	{
		return rc;
	}

	if (tlv_info.it_magic != magic)
	{
		return -ENOENT;
	}

	*tlvs_start = start_off + sizeof(tlv_info);
	*tlvs_end = start_off + tlv_info.it_tlv_tot;
	return 0;
}

static int read_image_sha256_from_area(uint8_t area_id, uint8_t out_sha[IMG_MGMT_DATA_SHA_LEN])
{
	const struct flash_area *fa = NULL;
	int rc = flash_area_open(area_id, &fa);
	if (rc != 0)
	{
		return rc;
	}

	const size_t start_off = boot_get_image_start_offset(area_id);
	struct image_header hdr;

	rc = flash_area_read(fa, start_off, &hdr, sizeof(hdr));
	if (rc != 0)
	{
		goto out;
	}

	if (hdr.ih_magic != IMAGE_MAGIC)
	{
		rc = -EINVAL;
		goto out;
	}

	size_t tlv_info_off = start_off + hdr.ih_hdr_size + hdr.ih_img_size;
	size_t tlvs_start;
	size_t tlvs_end;

	if (find_tlv_area(fa, tlv_info_off, IMAGE_TLV_PROT_INFO_MAGIC, &tlvs_start, &tlvs_end) == 0)
	{
		tlv_info_off = tlvs_end;
	}

	rc = find_tlv_area(fa, tlv_info_off, IMAGE_TLV_INFO_MAGIC, &tlvs_start, &tlvs_end);
	if (rc != 0)
	{
		goto out;
	}

	for (size_t off = tlvs_start; off + sizeof(struct image_tlv) <= tlvs_end;)
	{
		struct image_tlv tlv;
		rc = flash_area_read(fa, off, &tlv, sizeof(tlv));
		if (rc != 0)
		{
			goto out;
		}

		if (tlv.it_type == IMAGE_TLV_SHA256 && tlv.it_len == IMG_MGMT_DATA_SHA_LEN)
		{
			const size_t val_off = off + sizeof(tlv);
			if (val_off + tlv.it_len > tlvs_end)
			{
				rc = -EINVAL;
				goto out;
			}

			rc = flash_area_read(fa, val_off, out_sha, tlv.it_len);
			goto out;
		}

		off += sizeof(tlv) + tlv.it_len;
	}

	rc = -ENOENT;
out:
	flash_area_close(fa);
	return rc;
}

static bool dfu_hook_image_update_completed(void)
{
	uint8_t sha[IMG_MGMT_DATA_SHA_LEN];
	char sha_hex[(IMG_MGMT_DATA_SHA_LEN * 2) + 1];

	const int area_id = g_img_mgmt_state.area_id;
	if (area_id < 0 || area_id > UINT8_MAX)
	{
		LOG_INF("Image upload completed (unknown flash area)");
		return false;
	}

	int rc = read_image_sha256_from_area((uint8_t)area_id, sha);
	if (rc != 0)
	{
		LOG_INF("Image upload completed (sha256 unavailable: %d)", rc);
		return false;
	}

	bin2hex(sha, sizeof(sha), sha_hex, sizeof(sha_hex));
	LOG_WRN("Image upload completed (sha256=%s)", sha_hex);

	return memcmp(sha, good_hash, sizeof(sha)) == 0;
}

static void dfu_hook_image_confirmed(unsigned int image)
{
	LOG_INF("Image %u confirmed", image);
}

#if defined(CONFIG_MCUMGR_MGMT_NOTIFICATION_HOOKS)
#include <zephyr/mgmt/mcumgr/mgmt/callbacks.h>

static enum mgmt_cb_return dfu_mgmt_event_cb(uint32_t event, enum mgmt_cb_return prev_status,
											 int32_t *rc, uint16_t *group, bool *abort_more,
											 void *data, size_t data_size)
{
	ARG_UNUSED(prev_status);
	ARG_UNUSED(rc);
	ARG_UNUSED(group);
	ARG_UNUSED(abort_more);
	ARG_UNUSED(data_size);

	switch (event)
	{
	case MGMT_EVT_OP_IMG_MGMT_DFU_PENDING:
		bool ok = dfu_hook_image_update_completed();
		if (!ok)
		{
			LOG_ERR("BAD HASH! ABANDONING!");

			struct img_mgmt_client img_client;
			img_mgmt_client_erase(&img_client, g_img_mgmt_state.area_id);
		}
		break;
	case MGMT_EVT_OP_IMG_MGMT_DFU_CONFIRMED:
		if ((data != NULL) && (data_size == sizeof(struct img_mgmt_image_confirmed)))
		{
			const struct img_mgmt_image_confirmed *confirmed = data;
			dfu_hook_image_confirmed(confirmed->image);
		}
		else
		{
			dfu_hook_image_confirmed(0);
		}
		break;
	default:
		break;
	}

	return MGMT_CB_OK;
}

static struct mgmt_callback dfu_cb = {
	.callback = dfu_mgmt_event_cb,
	.event_id = MGMT_EVT_OP_IMG_MGMT_DFU_PENDING | MGMT_EVT_OP_IMG_MGMT_DFU_CONFIRMED,
};
#endif

void dfu_hooks_register(void)
{
#if defined(CONFIG_MCUMGR_MGMT_NOTIFICATION_HOOKS)
	mgmt_callback_register(&dfu_cb);
#else
	LOG_WRN("DFU hooks disabled: enable CONFIG_MCUMGR_MGMT_NOTIFICATION_HOOKS");
#endif
}
```

## src/dfu_hooks.h
```c
#ifndef DFU_LOGGING_H_
#define DFU_LOGGING_H_

#include <zephyr/mgmt/mcumgr/grp/img_mgmt/img_mgmt.h>
#include <zephyr/mgmt/mcumgr/grp/img_mgmt/img_mgmt_client.h>

void dfu_hooks_register(void);

extern uint8_t good_hash[IMG_MGMT_DATA_SHA_LEN];

#endif
```
